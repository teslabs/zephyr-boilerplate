## app/boards/arm/app_board/Kconfig.board
```kconfig
# Application board configuration
# Copyright (c) 2020 Teslabs Engineering S.L.
# SPDX-License-Identifier: Apache-2.0

config BOARD_APP_BOARD
	bool "Application Development Board"
	depends on SOC_STM32F405XG
```

## app/boards/arm/app_board/Kconfig.defconfig
```kconfig
# Application board
# Copyright (c) 2020 Teslabs Engineering S.L.
# SPDX-License-Identifier: Apache-2.0

if BOARD_APP_BOARD

config BOARD
	default "app_board"

endif # BOARD_APP_BOARD
```

## app/src/Kconfig
```kconfig
# Copyright (c) 2020 Teslabs Engineering S.L.
# SPDX-License-Identifier: Apache-2.0

module = APP
module-str = APP
source "subsys/logging/Kconfig.template.log_config"
```
