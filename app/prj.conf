## CMakeLists.txt
```
#-------------------------------------------------------------------------------
# Application firmware
#
# Copyright (c) 2020 Teslabs Engineering S.L.
# SPDX-License-Identifier: Apache-2.0

if(NOT DEFINED BOARD_ROOT)
  set(BOARD_ROOT ${CMAKE_SOURCE_DIR})
endif()

if(NOT DEFINED BOARD)
  set(BOARD "app_board")
endif()

cmake_minimum_required(VERSION 3.13.1)
find_package(Zephyr REQUIRED HINTS $ENV{ZEPHYR_BASE})

project(app LANGUAGES C VERSION 1.0.0)

#-------------------------------------------------------------------------------
# Options

set(CMAKE_EXPORT_COMPILE_COMMANDS ON)

#-------------------------------------------------------------------------------
# Application

zephyr_include_directories(include)

add_subdirectory(src)
```

## Kconfig
```
# Copyright (c) 2020 Teslabs Engineering S.L.
# SPDX-License-Identifier: Apache-2.0

mainmenu "Application"

menu "Zephyr"
source "Kconfig.zephyr"
endmenu

menu "Application"
rsource "src/Kconfig"
endmenu
```

## west.yml
```
# Copyright (c) 2020 Teslabs Engineering S.L.
# SPDX-License-Identifier: Apache-2.0

manifest:
  self:
    path: app

  remotes:
    - name: zephyr
      url-base: https://github.com/zephyrproject-rtos

  projects:
    - name: zephyr
      remote: zephyr
      repo-path: zephyr
      revision: master
      import:
        path-whitelist:
          - modules/hal/cmsis
          - modules/hal/stm32
```

## prj.conf
```kconfig
# Copyright (c) 2020 Teslabs Engineering S.L.
# SPDX-License-Identifier: Apache-2.0
```

## .checkpatch.conf
```kconfig
--emacs
--summary-file
--show-types
--max-line-length=100
--min-conf-desc-length=1
--typedefsfile=scripts/checkpatch/typedefsfile

--ignore BRACES
--ignore PRINTK_WITHOUT_KERN_LEVEL
--ignore SPLIT_STRING
--ignore VOLATILE
--ignore CONFIG_EXPERIMENTAL
--ignore AVOID_EXTERNS
--ignore NETWORKING_BLOCK_COMMENT_STYLE
--ignore DATE_TIME
--ignore MINMAX
--ignore CONST_STRUCT
--ignore FILE_PATH_CHANGES
--exclude ext
```

## debug.conf
```kconfig
# Copyright (c) 2020 Teslabs Engineering S.L.
# SPDX-License-Identifier: Apache-2.0

# compiler
CONFIG_DEBUG_OPTIMIZATIONS=y

# uart console
CONFIG_SERIAL=y
CONFIG_CONSOLE=y
CONFIG_UART_CONSOLE=y
```

## boards/arm/app_board/app_board.dts
```dts
/*
 * Copyright (c) 2020 Teslabs Engineering S.L.
 * SPDX-License-Identifier: Apache-2.0
 */

/dts-v1/;
#include <st/f4/stm32f405Xg.dtsi>
#include <st/f4/stm32f405rgtx-pinctrl.dtsi>

/ {
	model = "Application board";
	compatible = "app_board";

	chosen {
		zephyr,console = &usart1;
		zephyr,shell-uart = &usart1;
		zephyr,sram = &sram0;
		zephyr,flash = &flash0;
	};
};

&usart1 {
	status = "okay";
	current-speed = <115200>;
	pinctrl-0 = <&usart1_tx_pa9 &usart1_rx_pa10>;
};
```

## src/main.c
```c
/*
 * Copyright (c) 2020 Teslabs Engineering S.L.
 * SPDX-License-Identifier: Apache-2.0
 */

#include <zephyr.h>

int main(void)
{
	printk("Hello from application\n");

	while (1) {
		k_sleep(K_MSEC(1000));
	}
}
```
